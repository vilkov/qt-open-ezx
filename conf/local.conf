## conf/local.conf
```bitbake
DL_DIR = "${PWD}/sources"
BBFILES := "${PWD}/toolchain/packages/*/*.bb"



# machine stuff. We want iwmmxt
MACHINE = "mvmdmachine"
TARGET_CC_ARCH = "-mcpu=iwmmxt -mtune=iwmmxt"
TARGET_ARCH = "arm"
TARGET_OS = "linux"
TARGET_FPU = "soft"
PACKAGE_ARCH = "iwmmxt"


# distro stuff
DISTRO  = "mvmd"
DISTRO_NAME = "mvmd"
DISTRO_VERSION = "x.y.z"
DISTRO_TYPE = "release"

# SPecial QtE handling. We will link the MT version
PALMTOP_USE_MULTITHREADED_QT="yes"


#INHERIT += " package_ipk package_tar debian "

#
# If you want to build your own toolchain comment this
#
#ASSUME_PROVIDED += " virtual/arm-linux-gcc virtual/libc "

###
# Common defines/variables
###
```

## toolchain/conf/distro/include/angstrom-2010-preferred-versions.inc
```bitbake
ANGSTROM_MESA_VERSION = "7.9.1"
ANGSTROM_QT_VERSION ?= "4.7.1"
ANGSTROM_LIBTOOL_VERSION = "2.4"
# Use new sysroot feature
LIBTOOL_HAS_SYSROOT = "yes"

CE_VERSION ?= "latest"

require conf/distro/include/angstrom-codec-engine-${CE_VERSION}-preferred-versions.inc

PREFERRED_VERSION_autoconf = "2.65"
PREFERRED_VERSION_autoconf-native = "2.65"
PREFERRED_VERSION_automake = "1.11.1"
PREFERRED_VERSION_automake-native = "1.11.1"
PREFERRED_VERSION_busybox 	= "1.18.3"
PREFERRED_VERSION_cairo		= "1.10.0"
PREFERRED_VERSION_dbus 		= "1.2.24"
PREFERRED_VERSION_dropbear      = "0.52"
PREFERRED_VERSION_fontconfig	= "2.8.0"
PREFERRED_VERSION_glib-2.0 	= "2.28.0"
PREFERRED_VERSION_glib-2.0-native = "2.28.0"
PREFERRED_VERSION_glibmm = "2.24.0"
PREFERRED_VERSION_gst-pulse 	= "0.9.7"
PREFERRED_VERSION_gtk+		= "2.20.1"
PREFERRED_VERSION_gtk+-native	= "2.20.1"
PREFERRED_VERSION_gtkmm		= "2.20.0"
PREFERRED_VERSION_gvfs 		= "1.7.2"
PREFERRED_VERSION_hal		= "0.5.14"
PREFERRED_VERSION_libgemwidget	= "1.0"
PREFERRED_VERSION_libgpephone	= "0.4"
PREFERRED_VERSION_libsdl-x11	= "1.2.14"
PREFERRED_VERSION_libtool           = "${ANGSTROM_LIBTOOL_VERSION}"
PREFERRED_VERSION_libtool-native    = "${ANGSTROM_LIBTOOL_VERSION}"
PREFERRED_VERSION_libtool-cross     = "${ANGSTROM_LIBTOOL_VERSION}"
PREFERRED_VERSION_libtool-nativesdk = "${ANGSTROM_LIBTOOL_VERSION}"
PREFERRED_VERSION_libtool-sdk       = "${ANGSTROM_LIBTOOL_VERSION}"
PREFERRED_VERSION_lighttpd      = "1.4.26"
PREFERRED_VERSION_mesa          = "${ANGSTROM_MESA_VERSION}"
PREFERRED_VERSION_mesa-dri      = "${ANGSTROM_MESA_VERSION}"
PREFERRED_VERSION_mesa-xlib     = "${ANGSTROM_MESA_VERSION}"
PREFERRED_VERSION_mythplugins   = "0.23"
PREFERRED_VERSION_myththemes    = "0.23"
PREFERRED_VERSION_mythtv        = "0.23"
PREFERRED_VERSION_mplayer       = "0.0+1.0rc3+svnr%"
PREFERRED_VERSION_network-manager-applet = "0.8.1"
PREFERRED_VERSION_networkmanager = "0.8.1"
PREFERRED_VERSION_networkmanager-openvpn = "0.8.1"
PREFERRED_VERSION_openssl = "1.0.0d"
PREFERRED_VERSION_openssl-native = "1.0.0d"
PREFERRED_VERSION_pango 	= "1.28.3"
PREFERRED_VERSION_pango-native     = "1.28.3"
PREFERRED_VERSION_perl = "5.10.1"
PREFERRED_VERSION_perl-native = "5.10.1"
#PREFERRED_VERSION_pixman	= "0.13.2"
PREFERRED_VERSION_pkgconfig	= "0.23"
PREFERRED_VERSION_pkgconfig-native = "0.23"
PREFERRED_VERSION_pulseaudio 	= "0.9.21"
PREFERRED_VERSION_python-pycairo = "1.8.0"
PREFERRED_VERSION_qt4-tools-native = "${ANGSTROM_QT_VERSION}"
PREFERRED_VERSION_qt4-tools-sdk = "${ANGSTROM_QT_VERSION}"
PREFERRED_VERSION_qt4-embedded = "${ANGSTROM_QT_VERSION}"
PREFERRED_VERSION_qt4-embedded-gles = "${ANGSTROM_QT_VERSION}"
PREFERRED_VERSION_qt4-x11-free = "${ANGSTROM_QT_VERSION}"
PREFERRED_VERSION_qt4-x11-free-gles = "${ANGSTROM_QT_VERSION}"

PREFERRED_VERSION_samba		= "3.3.9"
PREFERRED_VERSION_tiff 		= "3.9.4+4.0.0beta6"

PREFERRED_VERSION_udev 		= "165"
PREFERRED_VERSION_udev_libc-uclibc = "141"
UDEV_GE_141 = "1"

PREFERRED_VERSION_usbutils = "0.86"
PREFERRED_VERSION_wpa-supplicant = "0.7.3"
PREFERRED_VERSION_wget = "1.11.4"
PREFERRED_VERSION_xserver-common = "1.33"
PREFERRED_VERSION_xserver-kdrive = "1.4.0.90"
```
